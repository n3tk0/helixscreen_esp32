## src/Kconfig.projbuild
```kconfig
# SPDX-License-Identifier: GPL-3.0-or-later
menu "HelixScreen"

    config HELIX_WIFI_SSID
        string "WiFi SSID"
        default ""
        help
            Optional. Normally left empty and set on the device: with no WiFi
            saved, the screen opens WiFi setup on first boot. A value here is
            only used until something is saved on the device.

    config HELIX_WIFI_PASSWORD
        string "WiFi Password"
        default ""
        help
            WPA2 password for the SSID above. Leave blank for an open network.

    config HELIX_MOONRAKER_HOST
        string "Moonraker host"
        default "mainsailos.local"
        help
            Hostname or IP of the Moonraker instance (no scheme, no port).
            Can be changed on the device under Settings -> Printer.
            mDNS .local names work if CONFIG_LWIP_DNS_SUPPORT_MDNS_QUERIES is on.

    config HELIX_MOONRAKER_PORT
        int "Moonraker port"
        default 7125
        help
            Moonraker's HTTP/WebSocket port. Default 7125.

    config HELIX_MOONRAKER_API_KEY
        string "Moonraker API key (optional)"
        default ""
        help
            Only needed if Moonraker's [authorization] requires it for your
            client's IP. Leave blank for a trusted LAN client.

    config HELIX_DISPLAY_FLIP
        bool "Rotate the display 180 degrees"
        default n
        help
            The UI runs in landscape (320x240). Enable this if it appears
            upside down for the way the board is mounted. Touch input is
            rotated with it.

endmenu
```
